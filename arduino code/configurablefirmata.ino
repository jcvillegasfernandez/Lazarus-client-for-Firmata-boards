/*
 * configurablefirmata_full.ino generated by FirmataBuilder
 * Mon Mar 04 2019 15:47:16 GMT-0500 (EST)
 */

#include <ConfigurableFirmata.h>

#include <DigitalInputFirmata.h>
DigitalInputFirmata digitalInput;

#include <DigitalOutputFirmata.h>
DigitalOutputFirmata digitalOutput;

#include <AnalogInputFirmata.h>
AnalogInputFirmata analogInput;

#include <AnalogOutputFirmata.h>
AnalogOutputFirmata analogOutput;

//#include <Servo.h>
//#include <ServoFirmata.h>
//ServoFirmata servo;

//#include <Wire.h>
//#include <I2CFirmata.h>
//I2CFirmata i2c;

#include <OneWireFirmata.h>
OneWireFirmata oneWire;

//#include <AccelStepperFirmata.h>
//AccelStepperFirmata accelStepper;

#include <FirmataScheduler.h>
FirmataScheduler scheduler;

//#include <Encoder.h>
//#include <FirmataEncoder.h>
//FirmataEncoder encoder;

//#include <PS2Mouse.h>
//#include <FirmataPS2Mouse.h>
//FirmataPS2Mouse ps2mouse;

#include <Adafruit_NeoPixel.h>
#include <FirmataNeopixels.h>
FirmataNeopixels pixels;

#include <FirmataExt.h>
FirmataExt firmataExt;

#include <AnalogWrite.h>

#include <FirmataReporting.h>
FirmataReporting reporting;

void systemResetCallback()
{
  for (byte i = 0; i < TOTAL_PINS; i++) {
    if (IS_PIN_ANALOG(i)) {
      Firmata.setPinMode(i, ANALOG);
    } else if (IS_PIN_DIGITAL(i)) {
      Firmata.setPinMode(i, OUTPUT);
    }
  }
  firmataExt.reset();
}

void initTransport()
{
  // Uncomment to save a couple of seconds by disabling the startup blink sequence.
  Firmata.disableBlinkVersion();
  Firmata.begin(56700);
}

void initFirmata()
{
  Firmata.setFirmwareVersion(FIRMATA_FIRMWARE_MAJOR_VERSION, FIRMATA_FIRMWARE_MINOR_VERSION);

  firmataExt.addFeature(digitalInput);
  firmataExt.addFeature(digitalOutput);
  firmataExt.addFeature(analogInput);
  firmataExt.addFeature(analogOutput);
  //firmataExt.addFeature(servo);
  //firmataExt.addFeature(i2c);
  firmataExt.addFeature(oneWire);
  //firmataExt.addFeature(accelStepper);
  firmataExt.addFeature(scheduler);
  //firmataExt.addFeature(encoder);
  //firmataExt.addFeature(ps2mouse);   
  firmataExt.addFeature(pixels);     
  firmataExt.addFeature(reporting);
 

  Firmata.attach(SYSTEM_RESET, systemResetCallback);
}

void setup()
{
  initFirmata();

  initTransport();

  Firmata.parse(SYSTEM_RESET);
}

void loop()
{
  digitalInput.report();

  while(Firmata.available()) {
    Firmata.processInput();
    if (!Firmata.isParsingMessage()) {
      goto runtasks;
    }
  }
 if (!Firmata.isParsingMessage()) {
runtasks: scheduler.runTasks();
  }

  if (reporting.elapsed()) {
    analogInput.report();
    //i2c.report();
    //encoder.report();
    //ps2mouse.report();
    pixels.update();
  }
  //accelStepper.update();
}
